## boards/arm/ngultra_bring_up/Kconfig.board
```kconfig
# Copyright (c) 2022 NanoXplore
# SPDX-License-Identifier: Apache-2.0

config BOARD_NGULTRA_BRING_UP
	bool "Bring-up board for NG-Ultra"
	depends on SOC_NGULTRA
```

## boards/arm/ngultra_bring_up/Kconfig.defconfig
```kconfig
# Copyright (c) 2022 NanoXplore
# SPDX-License-Identifier: Apache-2.0

if BOARD_NGULTRA_BRING_UP
config BOARD
	default "ngultra_bring_up"
endif # BOARD_NGULTRA_BRING_UP
```

## boards/arm/ngultra_bring_up/ngultra_bring_up_defconfig
```kconfig
CONFIG_SOC_NGULTRA=y
CONFIG_SOC_SERIES_NANOXPLORE_NGULTRA=y
CONFIG_BOARD_NGULTRA_BRING_UP=y
CONFIG_CLOCK_CONTROL=n
CONFIG_SYS_CLOCK_HW_CYCLES_PER_SEC=100000000
CONFIG_FLASH_SIZE=0
CONFIG_FLASH_BASE_ADDRESS=0
```

## drivers/serial/Kconfig.nx
```kconfig
# NanoXplore UART

# Copyright (c) 2022, NanoXplore
# SPDX-License-Identifier: Apache-2.0

config UART_NX_NGULTRA
	bool "NanoXplore UART driver"
	select SERIAL_HAS_DRIVER
	help
	  This option enables the UART driver for NG-Ultra.
```

## dts/bindings/serial/nanoxplore,ngultra-uart.yaml
```yaml
# Copyright (c) 2022, NanoXplore
# SPDX-License-Identifier: Apache-2.0

description: NanoXplore UART

compatible: "nanoxplore,ngultra-uart"

include: uart-controller.yaml

properties:
    reg:
      required: true

    current-speed:
     type: int
     required: true
     description: Configure the UART baudrate
```

## soc/arm/nanoxplore_ng/ngultra/Kconfig.defconfig.ngultra
```kconfig
# Copyright (c) 2022 NanoXplore
# SPDX-License-Identifier: Apache-2.0

if SOC_NGULTRA

config SOC
	default "ngultra"

config NUM_IRQS
	default 192

config UART_NX_NGULTRA
	default y
	depends on SERIAL

endif # SOC_NGULTRA
```
