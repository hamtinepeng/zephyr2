/*
 * Copyright (c) 2022 NanoXplore
 *
 * SPDX-License-Identifier: Apache-2.0
 *
 */

/dts-v1/;
#include <arm/nanoxplore/ng/ngultra.dtsi>

/ {
	model = "NanoXplore bring-up board";
	compatible = "nanoxplore,bring_up";

	chosen {
		zephyr,sram = &eram0;
		zephyr,console = &uart0;
	};
};
